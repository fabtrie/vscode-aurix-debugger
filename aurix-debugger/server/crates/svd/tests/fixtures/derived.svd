# DERIVED register map
Registers are 16-bit, access not given, no defined reset value unless marked. A register's access mark holds for its fields unless they carry their own. Offsets are from the block's base; lines under a group give offsets from that group; [hi:lo] are bit positions; {n}, {i} and the like mark numbered series; 'fields as' and 'values as' point back to an identical list; <NAME> marks a mode.

## Memory map
0xF0000000 COPY_FIRST size 0x40
0xF0001000 BASE size 0x40 — The base
0xF0002000 COPY size 0x40 — Derived, with its own registers element replacing the base's
0xF0003000 TWICE
0xF0004000 OTHER
0xF0005000 TWICE — The later one wins, at the place of the first

## BASE — The base
Base 0xF0001000
Same registers: COPY_FIRST 0xF0000000
0x00 CTRL
  [0] EN
    0=OFF; 1=ON

## COPY — Derived, with its own registers element replacing the base's
Base 0xF0002000
0x00 CTRL
  [0] EN
    0=OFF; 1=ON
0x04 CTRL2
  [0] EN
    0=OFF; 1=ON
