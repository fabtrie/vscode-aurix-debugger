# EXTRA register map
Registers are 8-bit, access not given, no defined reset value unless marked. A register's access mark holds for its fields unless they carry their own. Offsets are from the block's base; lines under a group give offsets from that group; [hi:lo] are bit positions; {n}, {i} and the like mark numbered series; 'fields as' and 'values as' point back to an identical list; <NAME> marks a mode.

## Memory map
0xF0040000 HSM
0xF0050000 HSM_BRIDGE_HSMSIDE
0xF0060000 HSM_CRYPTO

## Interrupts
3 HSM_IRQ (HSM)

## HSM
Base 0xF0040000
0x00 ID
