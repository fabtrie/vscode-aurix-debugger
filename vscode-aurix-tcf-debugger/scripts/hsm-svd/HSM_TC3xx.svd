# HSM_TC3xx register map
Vendor: Infineon; Series: AURIX TC3xx; File version: 2.0
Hardware Security Module (HSM) of the AURIX TC3xx family (Cortex-M3 r2p0). HSM-internal peripherals (0xE0000000-0xEFFFFFFF) are reached by the host through the HSM debug window and only while DBGCTRL.HSM is set by the HSM firmware.
CPU: CM3 r2p0, little endian, MPU, no FPU, 3 interrupt priority bits
Registers are 32-bit, read-write, no defined reset value unless marked. A register's access mark holds for its fields unless they carry their own. Offsets are from the block's base; lines under a group give offsets from that group; [hi:lo] are bit positions; {n}, {i} and the like mark numbered series; 'fields as' and 'values as' point back to an identical list; <NAME> marks a mode.

## Memory map
0xE0001000 HSM_DWT size 0x60 — Cortex-M3 data watchpoint and trace unit, 4 comparators. The comparators are used by the debug server for watchpoints; read-only here.
0xE0002000 HSM_FPB size 0x1000 — Cortex-M3 flash patch and breakpoint unit, 6 usable code comparators with the HSM's FP_COMPHx extension for 32-bit addresses (HSM TS 12.4.1). Used by the debug server for breakpoints; read-only here.
0xE000E000 HSM_SCNSCB size 0x10 — Cortex-M3 system control, not in the SCB (ARMv7-M).
0xE000E010 HSM_SYSTICK size 0x10 — Cortex-M3 SysTick timer. Reference clock: SPB clock / 16. Suspended in HALT mode (HSM TS 2.2.2).
0xE000E100 HSM_NVIC size 0xE04 — Cortex-M3 NVIC: 10 interrupts, 8 priority levels (3 bits, 7:5 of each priority byte). HSM TS 2.3.
0xE000ED00 HSM_SCB size 0x40 — Cortex-M3 System Control Block (ARMv7-M, HSM TS 2.2).
0xE000ED90 HSM_MPU size 0x2C — Cortex-M3 memory protection unit, 8 regions (PMSAv7; C, S and TEX are ignored on the HSM, HSM TS 2.4).
0xE000EDF0 HSM_COREDEBUG size 0x10 — Cortex-M3 core debug registers. Used by the debug server for run control; read-only here.
0xE008A000 HSM_CACHE size 0x120 — HSM unified cache (HSM TS 2.5.3). Privileged access only. The command registers are write-only and trigger cache operations.
0xE8000000 HSM_AES size 0x400 — AES-128 module (HSM TS 4.4). Only 32-bit accesses; unused addresses give a bus error. Not suspended in HALT mode.
0xE8000400 HSM_HASH size 0x400 — Hash module MD5/SHA-1/SHA-224/SHA-256 (HSM TS 5.3). Only 32-bit accesses; reading a write-only register gives a bus error.
0xE8003C00 HSM_PKC size 0x10 — Public Key Cryptography module, control and status (HSM TS 6.4.1). Only 32-bit accesses.
0xE8004000 HSM_PKC_SCM size 0x400 — PKC Shared Crypto Memory: 32 long integer registers of 256 bits (HSM TS 6.4.2). Only expand while PKC_STATUS.BUSY = 0: the SCM must not be accessed while the PKC is working.
0xEC000000 HSM_TIM size 0x100 — Timer module, timer 0 and timer 1 (HSM TS 7.4). 16-bit registers, addressed wordwise. Suspended in HALT mode.
0xEC000100 HSM_WDT size 0x100 — HSM watchdog timer (HSM TS 8.4). 16-bit registers, addressed wordwise. Suspended in HALT mode; its interrupt is the NMI.
0xEC000200 HSM_TRNG size 0x100 — True random number generator (HSM TS 3.4). Suspended in HALT mode.
0xF0040000 HSM_BRIDGE size 0x1100 — HSM bridge, host side (HSM TS 9.3.1, 9.4). Only 32-bit aligned accesses. DBGBASE and HSMOTGB are only accessible while HSM debugging is enabled (DBGCTRL.HSM).
0xF0040000 HSM_BRIDGE_HSMSIDE size 0x100 — HSM bridge, registers accessible by the HSM only (HSM TS 9.3.1-9.3.7). A host access gives a bus error; a debugger access through the HSM debug window reaches a host address through the HSM (possible SPB bus conflict, HSM TS 12.3.6).

## Interrupts
0 HSM_TIM0 (HSM_TIM) — Timer 0 overflow interrupt
1 HSM_TIM1 (HSM_TIM) — Timer 1 overflow interrupt
2 HSM_TRNG — True random number generator interrupt
3 HSM_BRIDGE_SRV (HSM_BRIDGE_HSMSIDE) — HSM bridge service interrupt
4 HSM_BRIDGE_ERR (HSM_BRIDGE_HSMSIDE) — HSM bridge error interrupt
5 HSM_SENSOR (HSM_BRIDGE_HSMSIDE) — Sensor interrupt
6 HSM_EXT (HSM_BRIDGE_HSMSIDE) — External peripheral interrupt
8 HSM_PKC_RDY (HSM_PKC) — PKC ready interrupt
9 HSM_PKC_ERR (HSM_PKC) — PKC error interrupt
